#include "GUI.h"
#include "DIALOG.h"
//#include "stm32f1xx_hal.h"
#include "main.h"
#include <math.h>
#include <stdio.h>
#include "LCD_MD070SD.h" 

//----------------------------------------------------------------

void DspLogo(void);
void calibrate(void);
void DspABIDO(int y);


  U16 reDraw,graph,winId;
  WM_HWIN hFrame,hWin,hEnv,hGraph,hSeting;
  TEMPERATURE temperature[8];




Frame_t   Frame;
U8 locked;

extern GUI_CONST_STORAGE GUI_BITMAP bmlock;
extern GUI_CONST_STORAGE GUI_BITMAP bmlock2;
extern GUI_CONST_STORAGE GUI_BITMAP bmlight1;
extern GUI_CONST_STORAGE GUI_BITMAP bmlight2;
//extern void ReCreateWin(void);
//-----------------------------------------------------------------------------
static void _cbBkWindow(WM_MESSAGE * pMsg) {
  switch (pMsg->MsgId) {    
    case WM_PAINT:		
			  GUI_SetBkColor(0xa56e3a);
			  GUI_Clear(); 
			  DspABIDO(120);
         break;
    default:
      WM_DefaultProc(pMsg);
  }
}
//-----------------------------------------------------------------------------
/*static void _cbProcFun(WM_MESSAGE * pMsg) {

  switch (pMsg->MsgId) {
  case WM_PAINT:
 
    break;
  default:
    WM_DefaultProc(pMsg);
  }
}*/
//-----------------------------------------------------------------------------
static void setLock(void)
{
	if(locked) 
	BUTTON_SetBitmapEx(WM_GetDialogItem(Frame._hFrame,ID_BUTTON_LOCK),BUTTON_BI_UNPRESSED,&bmlight2,6,7);
   else
	BUTTON_SetBitmapEx(WM_GetDialogItem(Frame._hFrame,ID_BUTTON_LOCK),BUTTON_BI_UNPRESSED,&bmlight1,6,7);
	if(locked) {Ones[light].delay =0;Ones[light].msg =0;}
   else Ones[light].delay = OFFLIGHTTIME;	
}

static void _cbFrame(WM_MESSAGE * pMsg)
{	  
	  switch (pMsg->MsgId) 
	  {
		  case WM_NOTIFY_PARENT:
			if (pMsg->Data.v == WM_NOTIFICATION_RELEASED) 
			{
				  int Id = WM_GetId(pMsg->hWinSrc);       
				  
				  if (Id == ID_BUTTON_SET) 
				  {
					/*  if(!WM_IsWindow(hSeting)){
						  CreateSetOfs();
					  }else{
						  GUI_EndDialog(hSeting,0);
						  hSeting = NULL;					
					  }	*/
					  if(WM_IsWindow(hSeting)){
						   GUI_EndDialog(hSeting,0);
						   hSeting = NULL;	
					  }
				  }
				  else if (Id == ID_BUTTON_LOCK) 
				  {					 
					  locked = !locked;	
                 ParSave.lock = locked;				  
					  setLock();
					  Ones[save].delay = 4000;
				  }
			}
			break;
	  }
	  if (Frame.pOldFrame) {
		(*Frame.pOldFrame)(pMsg);
	  }
	  
}
static GUI_CONST_STORAGE unsigned char _aclight1[] = {
  0xFF,0xFF,0xFF, 0xFF,0xFF,0xFF, 0xFF,0xFF,0xFF, 0xFF,0xFF,0xFF,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0xFF, 
        0xFF,0xFF,0xFF, 0xFF,0xFF,0xFF, 0xFF,0xFF,0xFF, 0xFF,0xFF,0xFF, 0xFF,0xFF,0xFF, 0xFF,0xFF,0xFF, 0xFF,0xFF,0xFF, 0xFF,0xFF,0xFF, 0xFF,0xFF,0xFF, 0xFF,0xFF,0xFF,
  0xFF,0xFF,0xFF, 0xFF,0xFF,0xFF, 0xFF,0xFF,0xFF, 0xFF,0xFF,0xFF,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0x30, 
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        0xC6,0x94,0xB2, 0xFF,0xA5,0x54, 0xFF,0xA5,0x34, 0xFF,0xA5,0x34, 0xFF,0xA5,0x34, 0xFF,0xFF,0xFF, 0xFF,0xFF,0xFF, 0xFF,0xFF,0xFF, 0xFF,0xFF,0xFF, 0xFF,0xFF,0xFF
};

GUI_CONST_STORAGE GUI_BITMAP bmlight1 = {
  25, // xSize
  25, // ySize
  75, // BytesPerLine
  24, // BitsPerPixel
  (unsigned char *)_aclight1,  // Pointer to picture data
  NULL,  // Pointer to palette
  GUI_DRAW_BMPAM565
};
static GUI_CONST_STORAGE unsigned char _acset[] = {
  0xFF,0xFF,0xFF, 0xFF,0x32,0xF0, 0xFF,0x4B,0xD2, 0xFF,0x64,0x54,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0xD5, 
        0xDF,0x43,0x91, 0x6E,0xAD,0xF8, 0x84,0xB6,0x39, 0xE3,0x6C,0x73, 0xFC,0x6C,0xB5, 0xFF,0x74,0xF7, 0xFF,0x74,0xF6, 0xFF,0x74,0xF6, 0xFF,0x75,0x17, 0xFF,0x3A,0xEF,
  0xFF,0xFF,0xFF, 0xFF,0x32,0xF0, 0xFF,0x4B,0xD2, 0xFF,0x53,0xD2,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0xB5, 
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        0xFF,0xFF,0xFF, 0xFF,0xFF,0xFF, 0xFF,0xFF,0xFF, 0xFF,0xFF,0xFF, 0xFF,0xFF,0xFF, 0xFF,0xFF,0xFF, 0xFF,0xFF,0xFF, 0xFF,0xFF,0xFF, 0xFF,0xFF,0xFF, 0xFF,0xFF,0xFF
};

GUI_CONST_STORAGE GUI_BITMAP bmset = {
  25, // xSize
  25, // ySize
  75, // BytesPerLine
  24, // BitsPerPixel
  (unsigned char *)_acset,  // Pointer to picture data
  NULL,  // Pointer to palette
  GUI_DRAW_BMPAM565
};
//======================================================================
static GUI_CONST_STORAGE unsigned char _aclock[] = {
  0xFF,0xFF,0xFF, 0xFF,0xFF,0xFF, 0xFF,0xFF,0xFF, 0xFF,0x00,0x20,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0x76, 
        0xBC,0x5A,0xCC, 0xFF,0x9C,0xF5, 0xFF,0x73,0xD0, 0xFF,0x00,0x01, 0xFF,0x00,0x01, 0xFF,0x00,0x01, 0xFF,0x00,0x01, 0xFF,0x00,0x01, 0xFF,0xFF,0xFF, 0xFF,0xFF,0xFF,
  0xFF,0xFF,0xFF, 0xFF,0xFF,0xFF, 0xFF,0xFF,0xFF, 0xFF,0x00,0x20,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0x9E, 
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        0x12,0xCE,0xBB, 0x12,0xD6,0xDB, 0x12,0xDF,0x1C, 0x12,0xE7,0x5D, 0x12,0xE7,0x5D, 0x12,0xCE,0xBB, 0x2D,0xA5,0x55, 0xBA,0x7C,0x11, 0xFF,0xFF,0xFF, 0xFF,0xFF,0xFF
};

GUI_CONST_STORAGE GUI_BITMAP bmlock = {
  25, // xSize
  25, // ySize
  75, // BytesPerLine
  24, // BitsPerPixel
  (unsigned char *)_aclock,  // Pointer to picture data
  NULL,  // Pointer to palette
  GUI_DRAW_BMPAM565
};

static GUI_CONST_STORAGE unsigned char _aclock2[] = {
  0xFF,0x73,0xAF, 0xC2,0xB5,0xB8, 0x37,0xC6,0x39, 0x0F,0xE7,0x3C,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0xEC, 
        0xFF,0x5A,0xEC, 0xFF,0x5A,0xEC, 0xFF,0x5A,0xEC, 0xFF,0x7C,0x73, 0xFF,0x9D,0x77, 0xFF,0xB5,0xF8, 0xFF,0xB5,0xF9, 0xFF,0x6B,0xAF, 0xFF,0x63,0x4E, 0xFF,0x8C,0x92,
  0xAB,0x6B,0x6E, 0x1D,0xDE,0xFC, 0x00,0xDE,0xFB, 0x00,0xCE,0xDB,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0xEC, 
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        0xFF,0xFF,0xFF, 0xFF,0xFF,0xFF, 0xFF,0xFF,0xFF, 0xFF,0xFF,0xFF, 0xFF,0xFF,0xFF, 0xFF,0xFF,0xFF, 0xFF,0xFF,0xFF, 0xFF,0xFF,0xFF, 0xFF,0xFF,0xFF, 0xFF,0xFF,0xFF
};

GUI_CONST_STORAGE GUI_BITMAP bmlock2 = {
  25, // xSize
  25, // ySize
  75, // BytesPerLine
  24, // BitsPerPixel
  (unsigned char *)_aclock2,  // Pointer to picture data
  NULL,  // Pointer to palette
  GUI_DRAW_BMPAM565
};
static GUI_CONST_STORAGE unsigned char _aclight2[] = {
  0xA1,0xCF,0xFA, 0x89,0xC7,0xD9, 0x6E,0xB7,0xF8, 0x53,0xAF,0xD7,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0xD0, 
        0x04,0x77,0xD0, 0x07,0x77,0xD1, 0x0A,0x7F,0xD1, 0x11,0x87,0xD2, 0x1C,0x8F,0xD3, 0x29,0x97,0xD4, 0x39,0x9F,0xD5, 0x4D,0xAF,0xD6, 0x65,0xB7,0xD7, 0x80,0xBF,0xD8,
  0x94,0xC7,0xF9, 0x78,0xBF,0xD8, 0x59,0xB7,0xD7, 0x3F,0xAF,0xD6,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0x0A, 
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        0x94,0xBE,0x37, 0xC5,0xEF,0xFD, 0xCE,0xEF,0xFD, 0xD9,0xEF,0xFD, 0xE2,0xEF,0xFE, 0xEC,0xF7,0xFE, 0xF6,0xF7,0xFE, 0xFD,0xFF,0xFF, 0xFF,0xFF,0xFF, 0xFF,0xFF,0xFF
};

GUI_CONST_STORAGE GUI_BITMAP bmlight2 = {
  25, // xSize
  25, // ySize
  75, // BytesPerLine
  24, // BitsPerPixel
  (unsigned char *)_aclight2,  // Pointer to picture data
  NULL,  // Pointer to palette
  GUI_DRAW_BMPAM565
};
//-----------------------------------------------------------------------------
WM_HWIN CreateFrame(Frame_t* pUser,WM_CALLBACK* cbFun,const char * sText) 
{
	//static int bit;
	  WM_HWIN  hButton;
	  /*if(!bit) {*/WM_SetCreateFlags(WM_CF_MEMDEV);WM_SetCallback(WM_HBKWIN, _cbBkWindow); /*bit = 1;}*/
      pUser->_hFrame = FRAMEWIN_CreateEx(pUser->x0,pUser->y0,pUser->xsize,pUser->ysize,
		         WM_HBKWIN, WM_CF_SHOW, FRAMEWIN_CF_ACTIVE, 0,sText,cbFun);   
	  pUser->pOldFrame = WM_SetCallback(pUser->_hFrame, _cbFrame);    

	  FRAMEWIN_SetTitleHeight(pUser->_hFrame,40);
	  FRAMEWIN_SetFont(pUser->_hFrame, GUI_FONT_32B_1);
	  FRAMEWIN_SetTextAlign(pUser->_hFrame, GUI_TA_HCENTER | GUI_TA_VCENTER);

	  FRAMEWIN_AddMinButton(pUser->_hFrame, FRAMEWIN_BUTTON_RIGHT, 1);

	  hButton = FRAMEWIN_AddButton(pUser->_hFrame, FRAMEWIN_BUTTON_LEFT,1,ID_BUTTON_SET);
	  BUTTON_SetBitmapEx(hButton,BUTTON_BI_UNPRESSED,&bmset,5,5);

	  
	  hButton = FRAMEWIN_AddButton(pUser->_hFrame, FRAMEWIN_BUTTON_LEFT,10,ID_BUTTON_LOCK);
//	  BUTTON_SetBitmapEx(hButton,BUTTON_BI_UNPRESSED,&bmlock,5,6);
     setLock();

      return pUser->_hFrame;
}
//-----------------------------------------------------------------------------
static void setSkin(void)
{
	BUTTON_SetDefaultSkin   (BUTTON_SKIN_FLEX);
	CHECKBOX_SetDefaultSkin (CHECKBOX_SKIN_FLEX);
	DROPDOWN_SetDefaultSkin (DROPDOWN_SKIN_FLEX);
	FRAMEWIN_SetDefaultSkin (FRAMEWIN_SKIN_FLEX);
	HEADER_SetDefaultSkin   (HEADER_SKIN_FLEX);
	PROGBAR_SetDefaultSkin  (PROGBAR_SKIN_FLEX);
	RADIO_SetDefaultSkin    (RADIO_SKIN_FLEX);
	SCROLLBAR_SetDefaultSkin(SCROLLBAR_SKIN_FLEX);
	SLIDER_SetDefaultSkin   (SLIDER_SKIN_FLEX);
}

//-----------------------------------------------------------------------------
void MainTask(void)
{
	GUI_PID_STATE State;
	PROGBAR_Handle hProg;
	uint8_t set=0;
	int id =101,post;
	GUI_Init();	  
	setSkin();		
	lcdLight(16);		
   Frame.x0 = 0;
	Frame.y0 = 0;
	Frame.xsize = 800;
	Frame.ysize = 480;
	Times[calib] = 2000;
	while(GUI_TOUCH_GetState(&State)){
		 if(Times[calib] ==0) {
			 calibrate();
			 set = 1;
			 break;
		 }
	 }
	 if(Times[calib]>0){
		 Times[calib] =0;
	//	 GUI_SetBkColor(GUI_BLACK);
		 GUI_SetBkColor(0xa56e3a);
		 GUI_Clear();
		 DspABIDO(120);
		 GUI_Delay(300);
		 hProg = PROGBAR_CreateEx(100, 400,600,15,WM_HBKWIN,  WM_CF_SHOW,PROGBAR_CF_HORIZONTAL, id);
		 PROGBAR_SetMinMax(hProg, 0, 4000);
		 for(post=0;post<=4000;post+=100){
			 PROGBAR_SetValue(hProg,post);
		    GUI_Delay(100);
		 }
		 WM_HideWindow(hProg);
	 }
    CreateFrame(&Frame,0,"Leakage detector");
	 Creategraph(); 
  
	 if(set) CreateSetOfs();
	 
 
}
 
